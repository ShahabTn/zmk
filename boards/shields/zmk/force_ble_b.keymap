/*
 * Side-B has no switches. The central Side-A owns the active keymap.
 */

/ {
    keymap {
        compatible = "zmk,keymap";

        default_layer {
            bindings = <>;
        };
    };
};
