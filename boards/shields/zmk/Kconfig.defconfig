## boards/shields/zmk/Kconfig.defconfig
```kconfig
if SHIELD_FORCE_BLE

config ZMK_KEYBOARD_NAME
    default "ZMK-BLE"

endif

if SHIELD_FORCE_BLE_A

config ZMK_KEYBOARD_NAME
    default "ZMK-BLE"

config ZMK_SPLIT_ROLE_CENTRAL
    default y

endif

if SHIELD_FORCE_BLE_A || SHIELD_FORCE_BLE_B

config ZMK_SPLIT
    default y

config ZMK_SPLIT_BLE_CENTRAL_PERIPHERALS
    default 1

endif
```

## boards/shields/zmk/Kconfig.shield
```kconfig
config SHIELD_FORCE_BLE
    def_bool $(shields_list_contains,force_ble)

config SHIELD_FORCE_BLE_A
    def_bool $(shields_list_contains,force_ble_a)

config SHIELD_FORCE_BLE_B
    def_bool $(shields_list_contains,force_ble_b)
```

## dts/bindings/behaviors/zmk,behavior-esp-remap.yaml
```yaml
description: ESP32 live remap behavior

compatible: "zmk,behavior-esp-remap"

include: behavior-metadata.yaml

properties:
  "#binding-cells":
    type: int
    const: 1

binding-cells:
  - position
```
