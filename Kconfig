## Kconfig
```kconfig
menu "ZMK ESP Bridge"

config ZMK_ESP_UART_BRIDGE
    bool "Send key position events to ESP32 over UART"
    default y
    depends on SERIAL

endmenu
```

## dts/bindings/behaviors/zmk,behavior-uart-ping.yaml
```yaml
description: UART ping behavior

compatible: "zmk,behavior-uart-ping"

include: behavior-metadata.yaml

properties:
  "#binding-cells":
    type: int
    const: 0
```
